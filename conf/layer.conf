## conf/layer.conf
```bitbake
BBPATH .= ":${LAYERDIR}"

# We have recipes-* directories, add to BBFILES
BBFILES += "${LAYERDIR}/recipes-*/*/*.bb \
	${LAYERDIR}/recipes-*/*/*.bbappend"

BBFILE_COLLECTIONS += "wr-ros-demo"
BBFILE_PATTERN_wr-ros-demo = "^${LAYERDIR}/"
BBFILE_PRIORITY_wr-ros-demo = "6"
```
